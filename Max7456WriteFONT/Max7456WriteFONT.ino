#include "Arduino.h"
#include <SPI.h>  //<> => standart location
#include "max7456/max7456.h" //"" => local location
#include "max7456/max7456.cpp"
#include "max7456/max7456registers.h"


Max7456 osd;
//THIS ARRAY IS OBTAINED BY AN OTHER PROGRAM
//Those 13.5ko of data are stored in the program memory.
//Be awared that 0xFF are stored as 0x55 as program memory can't stand series of 0xFF (Arduino vicious problem)
const char tableOfAllCharacters[13824] PROGMEM = { 0x55,0x55,0x55,0x55,0x55,0x55,0x55,0x55,0x55,0x55,0x55,0x55,0x55,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0x55,
0xAA,0xAA,0xAA,0xAA,0xAA,0xAA,0xAA,0xAA,0xAA,0xAA,0xAA,0xAA,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0xAA,
0x55,0x55,0x55,0xFC,0x55,0x3F,0xF2,0x3C,0x8F,0xCA,0x82,0xA3,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0x55,
0xAA,0xAA,0xAA,0xAA,0xAA,0xAA,0xAA,0xAA,0xAA,0xAA,0xAA,0xAA,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0xAA,
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0xAA,0xAA,0xAA,0xAA,0xAA,0xAA,0xAA,0xAA,0xAA,0xAA,0xAA,0xAA,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0xAA 
 };


void setup()
{
  //Sample code : Write a complete table of character in the character memory of the max7456.
  charact currentChar; //represents a character as stored in memory (byte[54])
  Serial.begin(9600);
  SPI.begin();
  osd.init(6);
  //osd = new Max7456(6); //new Max7456 with CS on pin 6.

  Serial.println("INSERTING CHARACTERS TABLE IN MAX7456");
  Serial.println("ARE YOU SURE ? (y/n)");
  bool goodChar = false;
  osd.activateOSD(false); // Deactivate osd display.
  //Just some serial manipulations
  while (!goodChar)
  {
    while (!Serial.available() );
    char found;
    found =  char(Serial.read());
    goodChar = (found == 'y' || found == 'Y');
    if (found == 'n' || found == 'N')
    {
      Serial.println("------ NOTHING DONE ------");
      Serial.println("please unplug your arduino");
      while (true);
    }
  }

  char number[] = "000";
  for (int i = 0 ; i <= 0xff; i++)
  {
    delay(70);
    Serial.println();
    Serial.print("inserting ");
    dtostrf(i, 3, 0, number);
    Serial.print(number);
    Serial.print(" / 255");

    //buggy
    osd.getCARACFromProgMem(tableOfAllCharacters, i, currentChar); //Because the table is too big for ram memory
    osd.sendCharacter(currentChar, i & 0xF0, i & 0xF0); //We send currentChar at address i.

    for (int j = 0 ; j < 19 ; j++) //Rewind Serial.
      Serial.print(char(0x08));

  }
  Serial.println();
  Serial.println("--------- DONE ! ---------");
  Serial.println("please unplug your arduino");
}

void loop()
{
  //Nothing done here
}
